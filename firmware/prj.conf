## CMakeLists.txt
```
cmake_minimum_required(VERSION 3.22.0)

set(CMAKE_TRY_COMPILE_TARGET_TYPE "STATIC_LIBRARY")
set(MCUX_PROJ rpmsg_lite_bridge_cm7)
project(${MCUX_PROJ} LANGUAGES C CXX ASM)

set(SDK_ROOT /home/sharedaccount/m7_sdk_full/mcuxsdk)
set(BOARD_ROOT ${SDK_ROOT}/examples/_boards/evkmimx8mp)
set(EXAMPLE_ROOT ${BOARD_ROOT}/multicore_examples/rpmsg_lite_str_echo_rtos)

# 1. ARCHITECTURE
set(SPECIFIC_FLAGS -mcpu=cortex-m7 -mthumb -mfloat-abi=hard -mfpu=fpv5-sp-d16)
add_compile_options(${SPECIFIC_FLAGS})
add_link_options(${SPECIFIC_FLAGS})

# 2. DEFINE EXECUTABLE
add_executable(${MCUX_PROJ} src/main.c)

# 3. IDENTITY & OS FEATURES
target_compile_definitions(${MCUX_PROJ} PRIVATE
    CPU_MIMX8ML8DVNLZ_cm7
    __USE_SHMEM
    SDK_OS_FREE_RTOS
    MCUXPRESSO_SDK
    FSL_RTOS_FREE_RTOS
    INCLUDE_vTaskDelete=1
)

# 4. SOURCES (Prefixing local files with src/)
target_sources(${MCUX_PROJ} PRIVATE
    src/pin_mux.c 
    src/hardware_init.c 
    src/board.c 
    src/clock_config.c 
    src/system_MIMX8ML8_cm7.c
    ${SDK_ROOT}/devices/i.MX/i.MX8MP/MIMX8ML8/gcc/startup_MIMX8ML8_cm7.S
    ${SDK_ROOT}/drivers/common/fsl_common.c
    ${SDK_ROOT}/drivers/common/fsl_common_arm.c
    ${SDK_ROOT}/drivers/iuart/fsl_uart.c
    ${SDK_ROOT}/drivers/mu/fsl_mu.c
    ${SDK_ROOT}/drivers/rdc/fsl_rdc.c
    ${SDK_ROOT}/devices/i.MX/i.MX8MP/MIMX8ML8/drivers/fsl_clock.c
    ${SDK_ROOT}/devices/i.MX/i.MX8MP/MIMX8ML8/drivers/fsl_audiomix.c
    ${SDK_ROOT}/middleware/multicore/rpmsg-lite/lib/rpmsg_lite/rpmsg_lite.c
    ${SDK_ROOT}/middleware/multicore/rpmsg-lite/lib/common/llist.c
    ${SDK_ROOT}/middleware/multicore/rpmsg-lite/lib/rpmsg_lite/porting/environment/rpmsg_env_freertos.c
    ${SDK_ROOT}/middleware/multicore/rpmsg-lite/lib/virtio/virtqueue.c
    ${SDK_ROOT}/middleware/multicore/rpmsg-lite/lib/rpmsg_lite/rpmsg_ns.c
    ${SDK_ROOT}/middleware/multicore/rpmsg-lite/lib/rpmsg_lite/rpmsg_queue.c
    ${SDK_ROOT}/middleware/multicore/rpmsg-lite/lib/rpmsg_lite/porting/platform/imx8mp_m7/rpmsg_platform.c
    ${SDK_ROOT}/components/debug_console_lite/fsl_debug_console.c
    ${SDK_ROOT}/components/uart/fsl_adapter_iuart.c
    ${SDK_ROOT}/components/str/fsl_str.c
    ${SDK_ROOT}/rtos/freertos/freertos-kernel/tasks.c
    ${SDK_ROOT}/rtos/freertos/freertos-kernel/list.c
    ${SDK_ROOT}/rtos/freertos/freertos-kernel/queue.c
    ${SDK_ROOT}/rtos/freertos/freertos-kernel/timers.c
    ${SDK_ROOT}/rtos/freertos/freertos-kernel/event_groups.c
    ${SDK_ROOT}/rtos/freertos/freertos-kernel/portable/MemMang/heap_4.c
    ${SDK_ROOT}/rtos/freertos/freertos-kernel/portable/GCC/ARM_CM7/r0p1/port.c
    ${BOARD_ROOT}/rsc_table.c
)

# 5. INCLUDES (Adding . and src to find app.h and pin_mux.h)
target_include_directories(${MCUX_PROJ} PRIVATE
    src
    .
    ${BOARD_ROOT}
    ${EXAMPLE_ROOT}
    ${EXAMPLE_ROOT}/remote
    ${SDK_ROOT}/arch/arm/CMSIS/Core/Include
    ${SDK_ROOT}/devices/i.MX/i.MX8MP/MIMX8ML8
    ${SDK_ROOT}/devices/i.MX/i.MX8MP/MIMX8ML8/drivers
    ${SDK_ROOT}/devices/i.MX/i.MX8MP/periph
    ${SDK_ROOT}/drivers/common
    ${SDK_ROOT}/drivers/iuart
    ${SDK_ROOT}/drivers/mu
    ${SDK_ROOT}/drivers/rdc
    ${SDK_ROOT}/components/uart
    ${SDK_ROOT}/components/debug_console_lite
    ${SDK_ROOT}/components/str
    ${SDK_ROOT}/middleware/multicore/remoteproc
    ${SDK_ROOT}/middleware/multicore/rpmsg-lite/lib/include
    ${SDK_ROOT}/middleware/multicore/rpmsg-lite/lib/include/platform/imx8mp_m7
    ${SDK_ROOT}/middleware/multicore/rpmsg-lite/lib/include/environment/freertos
    ${SDK_ROOT}/rtos/freertos/freertos-kernel/include
    ${SDK_ROOT}/rtos/freertos/freertos-kernel/portable/GCC/ARM_CM7/r0p1
)

# 6. LINKER
set(LINKER_SCRIPT ${SDK_ROOT}/examples/_boards/evkmimx8mp/gcc/MIMX8ML8xxxxx_cm7_lpa_ram.ld)
target_link_options(${MCUX_PROJ} PRIVATE
    -T${LINKER_SCRIPT}
    ${SPECIFIC_FLAGS}
    --specs=nano.specs
    --specs=nosys.specs
    -Wl,--gc-sections
    -Wl,--print-memory-usage
)
```

## prj.conf
```kconfig
# Core and SDK basic settings
CONFIG_DEVICE_ID="MIMX8ML8"
CONFIG_BOARD_ID="evkmimx8mp"

# Enable Multi-core communication
CONFIG_COMPONENT_MULTICORE_RPMSG_LITE=y
CONFIG_COMPONENT_MULTICORE_RPMSG_LITE_FREE_RTOS=y

# Enable FreeRTOS
CONFIG_COMPONENT_OS_FREE_RTOS=y

# Standard SDK components
CONFIG_COMPONENT_SDK_DEBUG_CONSOLE=y
CONFIG_COMPONENT_SDK_COMMON=y
```

## src/main.c
```c
/*
 * Milestone 2: RPMsg Sensor Bridge (Fake Data)
 */

#include <stdio.h>
#include <stdlib.h>
#include <string.h>

/* SDK and FreeRTOS Headers */
#include "rpmsg_lite.h"
#include "rpmsg_queue.h"
#include "rpmsg_ns.h"
#include "FreeRTOS.h"
#include "task.h"

/* Board and Application Specific Headers */
#include "board.h"
#include "app.h"
#include "fsl_debug_console.h"
#include "pin_mux.h"
#include "clock_config.h"

/*******************************************************************************
 * Definitions
 ******************************************************************************/
#define APP_TASK_STACK_SIZE (256)
#ifndef LOCAL_EPT_ADDR
#define LOCAL_EPT_ADDR (30)
#endif

/* Data Structure for Milestone 2 */
typedef struct __attribute__((packed)) {
    int32_t temp_c_x10;    /* 555 = 55.5C */
    uint16_t adc_ch0;      /* 0999 */
    uint16_t adc_ch1;      /* 1111 */
    uint16_t adc_ch2;      /* 2222 */
    uint16_t adc_ch3;      /* 3333 */
    uint32_t uptime_ms;    /* M7 Uptime */
} sensor_data_t;

/*******************************************************************************
 * Code
 ******************************************************************************/
static TaskHandle_t app_task_handle = NULL;
static struct rpmsg_lite_instance *volatile my_rpmsg = NULL;
static struct rpmsg_lite_endpoint *volatile my_ept = NULL;
static volatile rpmsg_queue_handle my_queue        = NULL;

void app_task(void *param)
{
    volatile uint32_t remote_addr = 0U;
    void *rx_buf;
    uint32_t len;
    int32_t result;
    void *tx_buf;
    uint32_t size;

    sensor_data_t sensor_payload = {
        .temp_c_x10 = 555,
        .adc_ch0 = 999,
        .adc_ch1 = 1111,
        .adc_ch2 = 2222,
        .adc_ch3 = 3333
    };

    PRINTF("\r\nRPMSG Sensor Bridge Demo (Fake Data)...\r\n");

    /* Initialize RPMsg */
    my_rpmsg = rpmsg_lite_remote_init((void *)RPMSG_LITE_SHMEM_BASE, RPMSG_LITE_LINK_ID, RL_NO_FLAGS);
    rpmsg_lite_wait_for_link_up(my_rpmsg, RL_BLOCK);

    my_queue = rpmsg_queue_create(my_rpmsg);
    my_ept   = rpmsg_lite_create_ept(my_rpmsg, LOCAL_EPT_ADDR, rpmsg_queue_rx_cb, my_queue);

    SDK_DelayAtLeastUs(1000000U, SDK_DEVICE_MAXIMUM_CPU_CLOCK_FREQUENCY);
    (void)rpmsg_ns_announce(my_rpmsg, my_ept, "rpmsg-virtual-tty-channel-1", RL_NS_CREATE);

    PRINTF("Ready for data requests on /dev/ttyRPMSG30...\r\n");

    for (;;)
    {
        result = rpmsg_queue_recv_nocopy(my_rpmsg, my_queue, (uint32_t *)&remote_addr, (char **)&rx_buf, &len, RL_BLOCK);
        if (result != 0) assert(false);

        /* Update uptime */
        sensor_payload.uptime_ms = xTaskGetTickCount() * portTICK_PERIOD_MS;

        /* Allocate and Send binary payload */
        tx_buf = rpmsg_lite_alloc_tx_buffer(my_rpmsg, &size, RL_BLOCK);
        assert(tx_buf);
        memcpy(tx_buf, &sensor_payload, sizeof(sensor_data_t));
        result = rpmsg_lite_send_nocopy(my_rpmsg, my_ept, remote_addr, tx_buf, sizeof(sensor_data_t));
        if (result != 0) assert(false);

        result = rpmsg_queue_nocopy_free(my_rpmsg, rx_buf);
        if (result != 0) assert(false);
    }
}

void app_create_task(void)
{
    if (xTaskCreate(app_task, "APP_TASK", APP_TASK_STACK_SIZE, NULL, tskIDLE_PRIORITY + 1, &app_task_handle) != pdPASS)
    {
        PRINTF("\r\nFailed to create application task\r\n");
        for (;;);
    }
}

int main(void)
{
    /* Initialize Hardware */
    BOARD_InitHardware();
    
    app_create_task();
    vTaskStartScheduler();
    for (;;);
}
```

## src/board.c
```c
/home/sharedaccount/m7_sdk_full/mcuxsdk/examples/_boards/evkmimx8mp/board.c
```

## src/clock_config.c
```c
/home/sharedaccount/m7_sdk_full/mcuxsdk/examples/_boards/evkmimx8mp/clock_config.c
```

## src/hardware_init.c
```c
/home/sharedaccount/m7_sdk_full/mcuxsdk/examples/_boards/evkmimx8mp/multicore_examples/rpmsg_lite_str_echo_rtos/remote/hardware_init.c
```

## src/pin_mux.c
```c
/home/sharedaccount/m7_sdk_full/mcuxsdk/examples/_boards/evkmimx8mp/multicore_examples/rpmsg_lite_str_echo_rtos/remote/pin_mux.c
```
